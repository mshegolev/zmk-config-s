## config/west.yml
```yaml
manifest:
  remotes:
    - name: zmkfirmware
      url-base: https://github.com/zmkfirmware
    - name: zbdm
      url-base: https://github.com/markfeinstein
  projects:
    - name: zmk
      remote: zmkfirmware
      revision: 904c9aec8822d79149d42c8a9a77e8828eb08f5a
      import: app/west.yml
    - name: zmk-behavior-dynamic-macro
      remote: zbdm
      revision: v0.1.0
      path: modules/zmk/zmk-behavior-dynamic-macro
  self:
    path: config
```
